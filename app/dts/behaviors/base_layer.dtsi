/*
 * Copyright (c) 2022 The ZMK Contributors
 *
 * SPDX-License-Identifier: MIT
 */

/ {
	behaviors {
		/omit-if-no-ref/ base: behavior_base_layer {
			compatible = "zmk,behavior-base-layer";
			label = "BASE_LAYER";
			#binding-cells = <1>;
		};
	};
};
