## app/dts/bindings/behaviors/zmk,behavior-base-layer.yaml
```yaml
# Copyright (c) 2022 The ZMK Contributors
# SPDX-License-Identifier: MIT

description: Base Layer

compatible: "zmk,behavior-base-layer"

include: one_param.yaml
```
